## config/starkissed_defconfig
```kconfig
CONFIG_LOCALVERSION="-Titania"

# TCP Congestion Control
CONFIG_TCP_CONG_ADVANCED=y
CONFIG_TCP_CONG_BIC=y
CONFIG_TCP_CONG_WESTWOOD=y
CONFIG_TCP_CONG_HSTCP=m
CONFIG_TCP_CONG_HYBLA=m
CONFIG_TCP_CONG_VEGAS=m
CONFIG_TCP_CONG_VENO=m
CONFIG_TCP_CONG_RENO=m
CONFIG_TCP_CONG_ILLINOIS=m
CONFIG_TCP_CONG_SCALABLE=m
CONFIG_TCP_CONG_LP=m
CONFIG_TCP_CONG_YEAH=m
CONFIG_TCP_CONG_ILLINOIS=m
CONFIG_DEFAULT_WESTWOOD=y
CONFIG_DEFAULT_TCP_CONG="westwood"

# CPU Overclock
CONFIG_TEGRA_CPU_CAP_OVERCLOCK=y

# CPU Governors
CONFIG_CPU_FREQ_GOV_DANCEDANCE=y
CONFIG_CPU_FREQ_GOV_LIONHEART=y
CONFIG_CPU_FREQ_GOV_SMARTMAX=y
CONFIG_CPU_FREQ_GOV_YANKACTIVE=y
CONFIG_CPU_FREQ_GOV_UMBRELLA_CORE=y
CONFIG_CPU_FREQ_GOV_RACCOON_CITY=y

# IO Schedulers
CONFIG_IOSCHED_SIO=y
CONFIG_IOSCHED_ZEN=y
CONFIG_IOSCHED_VR=y
CONFIG_IOSCHED_DEADLINE=y
CONFIG_IOSCHED_CFQ=y
CONFIG_IOSCHED_BFQ=y
CONFIG_IOSCHED_FIOPS=y

# Hotplug
CONFIG_INTELLI_PLUG=y

# IPV6
CONFIG_IPV6_USE_OPTIMISTIC=y

# Logo
CONFIG_LOGO_SKU_CLUT224=y

# DVFS
CONFIG_PM_DEVFREQ=y
CONFIG_DEVFREQ_GOV_SIMPLE_ONDEMAND=y
CONFIG_DEVFREQ_GOV_PERFORMANCE=y
CONFIG_DEVFREQ_GOV_POWERSAVE=y
CONFIG_DEVFREQ_GOV_USERSPACE=y

# Filesystems
CONFIG_CIFS=y
CONFIG_CIFS_WEAK_PW_HASH=y

# GCC
CONFIG_CC_OPTIMIZE_ALOT=y
```
